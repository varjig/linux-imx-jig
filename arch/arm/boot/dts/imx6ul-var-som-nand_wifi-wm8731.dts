/*
 * Copyright (C) 2025 Variscite Ltd. - http://www.variscite.com
 *
 * This program is free software; you can redistribute it and/or modify
 * it under the terms of the GNU General Public License version 2 as
 * published by the Free Software Foundation.
 */
/* NAND & WI-FI devices enabled eMMC & SDCARD disabled.*/
#define WIFI
/* #define EMMC */
#define  NAND
#define PHY
#include "imx6ul-var-som.dtsi"

#include "imx6ul-imx6ull-var-dart-wm8731.dtsi"

/ {
        model = "Variscite i.MX6 UL VAR-SOM NAND + WM8731";
};
