/*
 * Copyright (C) 2025 Variscite Ltd. - http://www.variscite.com
 *
 * This program is free software; you can redistribute it and/or modify
 * it under the terms of the GNU General Public License version 2 as
 * published by the Free Software Foundation.
 */
/* NAND & WI-FI devices enabled eMMC & SDCARD disabled.*/
#define WIFI
#define WIFI_5G
/* #define EMMC */
#define  NAND
#define PHY
#include "imx6ull-var-som.dtsi"
#include "imx6ul-imx6ull-var-som-wm8731.dtsi"

/ {
        model = "Variscite i.MX6 ULL VAR-SOM-5G NAND + WM8731 + WIFI";
};
