/*
 * Copyright (C) 2015-2024 Variscite Ltd. - http://www.variscite.com
 *
 * This program is free software; you can redistribute it and/or modify
 * it under the terms of the GNU General Public License version 2 as
 * published by the Free Software Foundation.
 */
#define WIFI
#define  NAND
#define PHY
#include "imx6ull-var-dart.dtsi"
#include "imx6ull-var-dart-wifi-iw61x.dtsi"
#include "imx6ul-imx6ull-var-dart-wm8904.dtsi"
/ {
        model = "Variscite i.MX6ULL DART/NAND/WiFi-IW61X/WM8904";
};

