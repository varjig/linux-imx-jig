/*
 * Copyright (C) 2015-2016 Variscite Ltd. - http://www.variscite.com
 *
 * This program is free software; you can redistribute it and/or modify
 * it under the terms of the GNU General Public License version 2 as
 * published by the Free Software Foundation.
 */
/* WI-FI & eMMC devices enabled NAND & SDCARD disabled.*/
#define WIFI
#define WIFI_5G
#define EMMC
#define PHY
/* #define  NAND */
#include "imx6ul-var-dart.dtsi"
#include "imx6ul-imx6ull-var-dart-wm8904.dtsi"
