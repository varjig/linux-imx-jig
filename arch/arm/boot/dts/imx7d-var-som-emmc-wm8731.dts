/*
 * Copyright (C) 2024 Variscite, Ltd. All Rights Reserved
 *
 * This program is free software; you can redistribute it and/or modify
 * it under the terms of the GNU General Public License version 2 as
 * published by the Free Software Foundation.
 */
#include "imx7d-var-som-emmc.dts"
#include "imx7d-var-som-wm8731.dtsi"

/ {
	model = "Variscite VAR-SOM-MX7 with eMMC & WM8731 on VAR-MX7CustomBoard";
	compatible = "fsl,imx7d-var-som", "fsl,imx7d";
};
