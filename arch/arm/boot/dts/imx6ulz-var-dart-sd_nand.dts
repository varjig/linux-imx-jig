/*
 * Copyright (C) 2019 Variscite Ltd. - http://www.variscite.com
 *
 * This program is free software; you can redistribute it and/or modify
 * it under the terms of the GNU General Public License version 2 as
 * published by the Free Software Foundation.
 */

#include "imx6ull-var-dart-sd_nand.dts"
#include "imx6ull_to_imx6ulz.dtsi"

/ {
	model = "Variscite i.MX6 ULZ DART NAND+WM8904";
	compatible = "fsl,imx6ulz-var-dart", "fsl,imx6ulz";
};
