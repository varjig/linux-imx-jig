/*
 * Copyright (C) 2024 Variscite Ltd. - http://www.variscite.com
 *
 * This program is free software; you can redistribute it and/or modify
 * it under the terms of the GNU General Public License version 2 as
 * published by the Free Software Foundation.
 */

/ {
	sound {
		compatible = "fsl,imx-audio-wm8731";
		model = "wm8731-audio";
		cpu-dai = <&sai2>;
		audio-codec = <&codec>;
		audio-routing =
			"Headphone Jack",	"LHPOUT",
			"Headphone Jack",	"RHPOUT",
			"LLINEIN",		"Line Jack",
			"RLINEIN",		"Line Jack";
	};
};
 
&i2c2 {
	codec: wm8731@1a {
		compatible = "wlf,wm8731";
		reg = <0x1a>;
		clocks = <&clks IMX6UL_CLK_SAI2>;
		clock-names = "mclk";
	};
};

