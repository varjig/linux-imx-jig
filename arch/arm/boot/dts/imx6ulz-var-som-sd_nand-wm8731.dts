/*
 * Copyright (C) 2025 Variscite Ltd. - http://www.variscite.com
 *
 * This program is free software; you can redistribute it and/or modify
 * it under the terms of the GNU General Public License version 2 as
 * published by the Free Software Foundation.
 */

#include "imx6ull-var-som-sd_nand-wm8731.dts"
#include "imx6ull_to_imx6ulz.dtsi"

/ {
	model = "Variscite i.MX6 ULZ SOM NAND/SD + WM8731";
	compatible = "fsl,imx6ulz-var-som", "fsl,imx6ulz";
};
