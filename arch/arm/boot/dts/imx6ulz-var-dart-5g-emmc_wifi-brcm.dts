/*
 * Copyright (C) 2019-2024 Variscite Ltd. - http://www.variscite.com
 *
 * This program is free software; you can redistribute it and/or modify
 * it under the terms of the GNU General Public License version 2 as
 * published by the Free Software Foundation.
 */
#include "imx6ull-var-dart-5g-emmc_wifi-brcm.dts"
#include "imx6ull_to_imx6ulz.dtsi"
/ {
	model = "Variscite i.MX6ULZ DART/eMMC/WIFI-5G-BRCM/WM8904";
	compatible = "fsl,imx6ulz-var-dart", "fsl,imx6ulz";
};
